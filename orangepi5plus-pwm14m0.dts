/dts-v1/;
/plugin/;

/ {

/*    compatible = "xunlong,orangepi-5-plus", "rockchip,rk3588-orangepi-5-plus", "rockchip,rk3588"; */

    fragment@0 {
        target = <&pwm14>;
        __overlay__ {
            status = "okay";
        };
    };
};

/* 
	** Enables pwm14 for userspace

        ## To install:

	* dtc -A -s -@ -I dts -O dtb -o /boot/dtb/rockchip/overlay/rk3588-pwm14m0.dtbo orangepi5plus-pwm14m0.dts 

        * Edit /boot/armbianEnv.txt and add
                overlays=pwm14m0   ( or:  orverlays=[existing] pwm14m0 )

        * reboot

*/

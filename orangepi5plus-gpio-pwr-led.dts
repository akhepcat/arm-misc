/*  For  OrangePi5+ boards only!! */

/dts-v1/;
/plugin/;

/ {

        fragment@0 {
                target-path = "/";
                __overlay__ {
                        leds: gpio-leds {
                                pwr_led@3 {
                                        gpios = <&gpio1 7 0>;
                                        label = "pwr_led";
                                        linux,default-trigger = "activity";
                                        linux,default-trigger-delay-ms = <0>;
                                };
                        };
                };
        };
};

/* 

Defines from the 'gpios = <&gpio3 [pin] [state]>'  line
  pin:  from linux/include/dt-bindings/pinctrl/rockchip.h
state:  linux/include/linux/gpio/machine.h:             #define GPIO_ACTIVE_HIGH   (0 << 0)

	 RK_PA7, aka GPIO1_A7, aka GPIO 39, aka pin 13	 #define RK_PA7            7

        (other available GPIOs, that aren't overloaded:  GPIO1_A4, GPIO1_B0, GPIO3_C1, ... )

        ## To install:

        * dtc -@ -O dtb -o /boot/dtb/rockchip/overlay/rk3588-gpio-pwr-led.dtbo orangepi5plus-gpio-pwr-led.dts

        *  Edit /boot/orangepiEnv.txt and add
                overlays=gpio-pwr-led   ( or:  orverlays=[existing] gpio-pwr-led )

        *  reboot

*/

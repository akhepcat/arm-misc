/*  For  RockPro64 boards only!! */

/dts-v1/;
/plugin/;

/ {

	fragment@0 {
		target = <&pcie0>;
		__overlay__ {
			max-link-speed = <0x02>;
		};
	};
};

/*
	for max-link-speed:   1 = PCIe gen1,   2 = PCIe gen 2,    no others are supported

        ## To install:

        * dtc -A -s -@ -I dts -O dtb -o /boot/dtb/rockchip/overlay/rockchip-pcie-gen2.dtbo rockpro64-pcie-gen2.dts

        * Edit /boot/armbianEnv.txt and add
                overlays=pcie-gen2   ( or:  orverlays=[existing] pcie-gen2 )

        * reboot
 */
